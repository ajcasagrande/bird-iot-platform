## components/nkolban/Kconfig.projbuild
```kconfig
menu "Niel Kolban's c++ wrappers"

config NKOLBAN
    bool "Enable nkolban component"
    default n
    help
        Select this option to use nkolban's c++ wrappers.

config NKOLBAN_NETWORKING
    bool "Networking utilities"
    depends on NKOLBAN
    default n
    help
        Select this option to use nkolban's c++ websocket http, ssl, wifi wrappers.

config NKOLBAN_EXTRA
    bool "Extra utilities"
    depends on NKOLBAN
    default n
    help
        Select this option to use various extra c++ wrappers.

menuconfig NKOLBAN_BLE
    bool "BLE utilities"
    depends on BT_ENABLED && NKOLBAN
    default n
    help
        Select this option to use nkolban's c++ bluetooth ble wrappers.

config NKOLBAN_BLE2902
    bool "BLE2902"
    depends on NKOLBAN_BLE
    default y if NKOLBAN_BLE
    help
        Select this option to use nkolban's c++ bluetooth BLE2902 wrappers.

endmenu
```
